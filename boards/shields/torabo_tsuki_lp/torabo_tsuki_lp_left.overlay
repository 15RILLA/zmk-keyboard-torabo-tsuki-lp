#include "torabo_tsuki_lp.dtsi"
#include <input/processors.dtsi>
#include <dt-bindings/zmk/input_transform.h>

//&pointing_listener {
//    input-processors = <&zip_xy_transform (INPUT_TRANSFORM_X_INVERT | INPUT_TRANSFORM_Y_INVERT)>;
//};

&pointing_listener {
    // 通常時の設定（変更なし）
    input-processors = <&zip_xy_transform (INPUT_TRANSFORM_X_INVERT | INPUT_TRANSFORM_Y_INVERT)>;

    // ▼ スクロールレイヤー用の設定（ここを修正） ▼
    scroll {
        layers = <3>; // ※ご自身のスクロール用レイヤー番号
        
        input-processors = 
            // 1. 上下のスクロール方向を逆にするため、Y_INVERT を削除しました。
            // （※もし左右も逆なら、この行を <&zip_xy_transform (0)> にしてください）
            <&zip_xy_transform (INPUT_TRANSFORM_X_INVERT)>,
            
            // 2. 移動をスクロールイベントに変換
            <&zip_xy_to_scroll_mapper>,
            
            // 3. 速度をさらに遅くする（1/4 から 1/10 へ変更。数字は好みで調整可能です）
            <&zip_scroll_scaler 1 10>;
    };
};
